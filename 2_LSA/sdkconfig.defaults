## 5_line_following/main/Kconfig
```kconfig
menu "Wall-E Configuration"

menu "SAC Junction Maze"
    config SAC_JUNCTION_MAZE
        bool "Enable left-hand junction maze exploration"
        default n
        help
            For non-looped line mazes. Requires track calibration before use.
            Disabling this preserves the original line follower.
    config SAC_WHITE_STRAIGHT
        bool "Drive straight across all-white areas (maximum 1 second)"
        depends on SAC_JUNCTION_MAZE
        default y
    config SAC_WHITE_HIGH
        bool "White surface reads ABOVE threshold on the LSA dashboard"
        depends on SAC_WHITE_STRAIGHT
        default n
        help
            Check all five readings over white. Enable if all exceed 820.
            Leave disabled if white readings are at or below 820.
            This is independent of line polarity.
    config SAC_AUTO_POLARITY
        bool "Automatically switch line polarity"
        depends on SAC_JUNCTION_MAZE
        default y
        help
            Confirms a narrow opposite-color interior stripe before switching.
            Ambiguous junctions can resemble inversion; test your actual course.
            Disable for fixed polarity or tracks with ambiguous split stripes.
    config SAC_MAZE_INVERT_LINE
        bool "Start with inverted maze line polarity"
        depends on SAC_JUNCTION_MAZE
        default n
    config SAC_MAZE_REVERSE_SENSORS
        bool "Reverse physical sensor order"
        depends on SAC_JUNCTION_MAZE
        default n
endmenu

menu "WiFi Config"
    config WIFI_SSID
        string "WiFi SSID"
        default "myssid"
        help
            SSID (network name) for the example to connect to.

    config WIFI_PASSWORD
        string "WiFi Password"
        default "mypassword"
        help
            WiFi password (WPA or WPA2) for the example to use.

    config MAXIMUM_RETRY
        int "Maximum retry"
        default 5
        help
            Set the Maximum retry to avoid station reconnecting to the AP unlimited when the AP is really inexistent.
endmenu

menu "mDNS Config"
    config MDNS_HOST_NAME
        string "mDNS host name (< 15 chars)"
        default "walle-tuning"
        help
            mDNS hostname used to access the tuning webpage, it should be less than 15 chars
endmenu

endmenu
```

## 6_self_balancing/sdkconfig.defaults
```kconfig
CONFIG_IDF_TARGET="esp32s3"
CONFIG_PARTITION_TABLE_SINGLE_APP_LARGE=y
CONFIG_ENABLE_OLED=y
```
