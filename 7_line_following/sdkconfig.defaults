## 7_line_following/sdkconfig.defaults
```kconfig
CONFIG_HTTPD_MAX_REQ_HDR_LEN=1024
CONFIG_SPIFFS_OBJ_NAME_LEN=64
CONFIG_FATFS_LONG_FILENAME=y
CONFIG_FATFS_LFN_HEAP=y
CONFIG_ESPTOOLPY_FLASHSIZE_4MB=y
CONFIG_PARTITION_TABLE_CUSTOM=y
CONFIG_PARTITION_TABLE_CUSTOM_FILENAME="partition_table.csv"
CONFIG_PARTITION_TABLE_FILENAME="partition_table.csv"
CONFIG_ENABLE_OLED=y
```

## components/esp-wifi-logger/Kconfig
```kconfig
menu "WiFi Logger configuration"

config ROUTE_ESP_IDF_API_LOGS_TO_WIFI
    bool "Route logs generated by ESP_LOGX to the wifi logger"
    default false
    help
        "Sets if logs generated by ESP-IDF logging API should be sent to remote logger"

config SERVER_IP_ADDRESS
    string "Server IP Address"
    default "192.168.0.10"
    help 
        "IP Address of server, where logs are to be sent"
    
config SERVER_PORT
    int "Port"
    default 9999
    help 
        "Port of server, where logs are to be sent"
        
config MESSAGE_QUEUE_SIZE
    int "Queue Size"
    default 1000
    help 
        "Sets message queue size"

config BUFFER_SIZE
    int "logger buffer size"
    default 512
    help 
        "Logger buffer size"
        
endmenu
```

## line_following/main/Kconfig
```kconfig
menu "Wall-E Configuration"

menu "WiFi Config"
    config WIFI_SSID
        string "WiFi SSID"
        default "myssid"
        help
            SSID (network name) for the example to connect to.

    config WIFI_PASSWORD
        string "WiFi Password"
        default "mypassword"
        help
            WiFi password (WPA or WPA2) for the example to use.

    config MAXIMUM_RETRY
        int "Maximum retry"
        default 5
        help
            Set the Maximum retry to avoid station reconnecting to the AP unlimited when the AP is really inexistent.
endmenu

menu "mDNS Config"
    config MDNS_HOST_NAME
        string "mDNS host name (< 15 chars)"
        default "walle-tuning"
        help
            mDNS hostname used to access the tuning webpage, it should be less than 15 chars
endmenu

endmenu
```

## self_balancing_with_line_following/main/Kconfig.projbuild
```kconfig
menu "Tuning parameters"

	config ESP_WIFI_SSID
		string "WiFi SSID"
		default "myssid"
		help
			SSID (network name) for the example to connect to.

	config ESP_WIFI_PASSWORD
		string "WiFi Password"
		default "mypassword"
		help
			WiFi password (WPA or WPA2) for the example to use.

	config UDP_LOGGER_ENABLE
		bool "Enable udp logger"
		default n
		help
			Enable WiFi UDP logger.

endmenu
```

## switch_controlled_motors/main/Kconfig.projbuild
```kconfig
menu "Tuning parameters"		
	config PARALLEL_MODE
		int "Parallel mode"
		default 1 
		help
			Change the mode of motor driver	
	config ESP_WIFI_SSID
		string "WiFi SSID"
		default "myssid"
		help
			SSID (network name) for the example to connect to.

	config ESP_WIFI_PASSWORD
		string "WiFi Password"
		default "mypassword"
		help
			WiFi password (WPA or WPA2) for the example to use.
endmenu
```
